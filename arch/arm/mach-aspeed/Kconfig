## arch/arm/mach-aspeed/Kconfig
```kconfig
if ARCH_ASPEED

config SYS_ARCH
	default "arm"

config SYS_SOC
	default "aspeed"

config SYS_TEXT_BASE
	default 0x00000000

choice
	prompt "Aspeed SoC select"
	depends on ARCH_ASPEED
	default ASPEED_AST2500

config ASPEED_AST2400
        bool "Support Aspeed AST2400 SoC"
        select CPU_ARM926EJS
        help
          The Aspeed AST2400 is a ARM-based SoC with arm926ejs CPU.
          It is used as Board Management Controller on many server boards,
          which is enabled by support of LPC and eSPI peripherals.

config ASPEED_AST2500
	bool "Support Aspeed AST2500 SoC"
	select CPU_ARM1176
	select SUPPORT_SPL
	help
	  The Aspeed AST2500 is a ARM-based SoC with arm1176 CPU.
	  It is used as Board Management Controller on many server boards,
	  which is enabled by support of LPC and eSPI peripherals.

config ASPEED_AST2600
	bool "Support Aspeed AST2600 SoC"
	select CPU_V7A
	select CPU_V7_HAS_NONSEC
	select ARCH_SUPPORT_PSCI
	select SYS_ARCH_TIMER
	select SUPPORT_SPL
	select ENABLE_ARM_SOC_BOOT0_HOOK
	help
	  The Aspeed AST2600 is a ARM-based SoC with Cortex-A7 CPU.
	  It is used as Board Management Controller on many server boards,
	  which is enabled by support of LPC and eSPI peripherals.
endchoice

config ASPEED_ALLOW_DANGEROUS_BACKDOORS
	bool "Expose options enabling dangerous Aspeed hardware backdoors"
	help
	  This option exposes configuration settings that create
	  critical security vulnerabilities by enabling dangerous
	  hardware backdoors in Aspeed BMCs.  Enable it only if
	  absolutely required for a specific system or for debugging
	  during development.

if ASPEED_ALLOW_DANGEROUS_BACKDOORS

config ASPEED_ENABLE_SUPERIO
	bool "Enable built-in AST2x00 Super I/O hardware"
	depends on ASPEED_AST2400 || ASPEED_AST2500
	help
	  The Aspeed AST2400 and AST2500 include a built-in Super I/O
	  device that is normally disabled; say Y here to enable it.

	  WARNING: this has serious security implications: it grants
	  the host read access to the BMC's entire address space.
	  This should thus be left disabled unless required by a
	  specific system.

config ASPEED_ENABLE_DEBUG_UART
	bool "Enable AST2500 hardware debug UART"
	depends on ASPEED_AST2500
	help
	  The Aspeed AST2500 include a hardware-supported, UART-based
	  debug interface that is normally disabled; say Y here to
	  enable it.

	  Note that this has security implications: the debug UART
	  provides read/write access to the BMC's entire address
	  space.  This should thus be left disabled on production
	  systems, but may be useful to enable for debugging during
	  development.

endif

config ASPEED_PALLADIUM
	bool "Aspeed palladium for simulation"
	default n
	help
	  Say Y here to enable palladium build for simulation.

	  This is mainly for internal verification and investigation
	  on HW design. If not sure, say N.

config ASPEED_SSP_RERV_MEM
	hex "Reserve memory for SSP"
	default 0x0
	help
	  The size in bytes of reserve memory for ASPEED SoC SSP run.

config ASPEED_DEFAULT_SPI_FREQUENCY
	bool "Using default SPI clock frequency"
	default n
	help
	  Using default SPI clock frequency during
	  early booting up progress.

source "arch/arm/mach-aspeed/ast2400/Kconfig"
source "arch/arm/mach-aspeed/ast2500/Kconfig"
source "arch/arm/mach-aspeed/ast2600/Kconfig"

endif
```

## configs/microwatt_defconfig
```kconfig
CONFIG_PPC=y
CONFIG_SYS_TEXT_BASE=0x0c000000
CONFIG_ENV_SIZE=0x10000
CONFIG_ENV_OFFSET=0xff0000
CONFIG_ENV_SECT_SIZE=0x10000
CONFIG_DEFAULT_DEVICE_TREE="microwatt"
CONFIG_MICROWATT=y
CONFIG_TARGET_ARTY_A7=y
CONFIG_PHYS_64BIT=y
CONFIG_OF_STDOUT_VIA_ALIAS=y
CONFIG_LOG=y
# CONFIG_BOOTM_PLAN9 is not set
# CONFIG_BOOTM_RTEMS is not set
# CONFIG_BOOTM_VXWORKS is not set
# CONFIG_CMD_IMI is not set
# CONFIG_CMD_XIMG is not set
CONFIG_CMD_DM=y
CONFIG_CMD_LSBLK=y
CONFIG_CMD_MMC=y
CONFIG_CMD_DHCP=y
CONFIG_CMD_MDIO=y
CONFIG_BOOTP_PREFER_SERVERIP=y
CONFIG_CMD_PING=y
CONFIG_CMD_EXT4=y
CONFIG_DOS_PARTITION=y
CONFIG_OF_CONTROL=y
CONFIG_OF_LIVE=y
CONFIG_OF_EMBED=y
CONFIG_ENV_IS_IN_SPI_FLASH=y
CONFIG_ENV_SECT_SIZE_AUTO=y
CONFIG_ENV_SPI_MAX_HZ=12500000
CONFIG_DM=y
CONFIG_REGMAP=y
CONFIG_SYSCON=y
CONFIG_DEVRES=y
CONFIG_SIMPLE_BUS_CORRECT_RANGE=y
CONFIG_CLK=y
CONFIG_CLK_CCF=y
CONFIG_MMC_BROKEN_CD=y
# CONFIG_MMC_QUIRKS is not set
# CONFIG_MMC_HW_PARTITIONING is not set
# CONFIG_MMC_VERBOSE is not set
CONFIG_MMC_LITEX=y
CONFIG_DM_SPI_FLASH=y
CONFIG_SF_DEFAULT_MODE=0x3
CONFIG_SPI_FLASH_BAR=y
# CONFIG_SPI_FLASH_UNLOCK_ALL is not set
CONFIG_SPI_FLASH_MACRONIX=y
CONFIG_SPI_FLASH_SPANSION=y
CONFIG_SPI_FLASH_STMICRO=y
CONFIG_SPI_FLASH_WINBOND=y
CONFIG_PHYLIB=y
CONFIG_DM_ETH=y
CONFIG_DM_MDIO=y
CONFIG_LITEETH=y
# CONFIG_PCI is not set
CONFIG_SPECIFY_CONSOLE_INDEX=y
CONFIG_DM_SERIAL=y
CONFIG_SERIAL_RX_BUFFER=y
CONFIG_SYS_NS16550=y
CONFIG_SPI=y
CONFIG_DM_SPI=y
CONFIG_MICROWATT_SPI=y
CONFIG_OF_LIBFDT_ASSUME_MASK=0x0
CONFIG_OF_LIBFDT_OVERLAY=y
```

## drivers/crypto/Kconfig
```kconfig
menu "Hardware crypto devices"

source drivers/crypto/fsl/Kconfig

config ASPEED_HACE
	bool "ASPEED Hash and Crypto Engine"
	select SHA_HW_ACCEL
	select SHA_PROG_HW_ACCEL
	help
	 Select this option to enable a driver for using the SHA engine in
	 the ASPEED BMC SoCs.

	 Enabling this allows the use of SHA operations in hardware without requiring the
	 SHA software implementations, saving code size.


endmenu
```
